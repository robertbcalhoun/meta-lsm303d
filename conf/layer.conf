## conf/layer.conf
```bitbake
# We have a conf and classes directory, add to BBPATH
BBPATH .= ":${LAYERDIR}"

# We have a recipes-* directories, add to BBFILES
BBFILES += "${LAYERDIR}/recipes-*/*/*.bb \
	${LAYERDIR}/recipes-*/*/*.bbappend"

BBFILE_COLLECTIONS += "meta-lsm303d"
BBFILE_PATTERN_meta-lsm303d = "^${LAYERDIR}/"
BBFILE_PRIORITY_meta-lsm303d = "6"

LAYERVERSION_meta-lsm303d = "1"
LAYERSERIES_COMPAT_meta-lsm303d = "warrior zeus"
```
